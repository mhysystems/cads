## buildroot-external/Config.in
```kconfig
source "$BR2_EXTERNAL_DEFAULT_PATH/package/hardware-nvidia/Config.in"
source "$BR2_EXTERNAL_DEFAULT_PATH/package/cads-edge/Config.in"
source "$BR2_EXTERNAL_DEFAULT_PATH/package/cpr/Config.in"
```

## buildroot-external/configs/jetson_nano_rootfs_defconfig
```kconfig
BR2_aarch64=y
BR2_cortex_a57=y
BR2_TOOLCHAIN_EXTERNAL=y
BR2_ROOTFS_DEVICE_CREATION_DYNAMIC_MDEV=y
BR2_GENERATE_LOCALE="en_US"
BR2_PACKAGE_DROPBEAR=y
BR2_TARGET_ROOTFS_EXT2=y
BR2_TARGET_ROOTFS_EXT2_4=y
BR2_TARGET_ROOTFS_EXT2_SIZE="4000M"
BR2_TARGET_ROOTFS_EXT2_MKFS_OPTIONS=""
BR2_TARGET_UBOOT=y
BR2_TARGET_UBOOT_BUILD_SYSTEM_KCONFIG=y
BR2_TARGET_UBOOT_CUSTOM_GIT=y
BR2_TARGET_UBOOT_CUSTOM_REPO_URL="git://nv-tegra.nvidia.com/3rdparty/u-boot.git"
BR2_TARGET_UBOOT_CUSTOM_REPO_VERSION="tegra-l4t-r32.7.1"
BR2_TARGET_UBOOT_BOARD_DEFCONFIG="p3450-0000"
BR2_TARGET_UBOOT_NEEDS_DTC=y
BR2_TARGET_UBOOT_FORMAT_DTB_BIN=y
BR2_TARGET_UBOOT_FORMAT_CUSTOM=y
BR2_TARGET_UBOOT_FORMAT_CUSTOM_NAME="u-boot.dtb"
BR2_PACKAGE_HOST_ENVIRONMENT_SETUP=y
BR2_PACKAGE_HOST_GENIMAGE=y
BR2_PACKAGE_HOST_GPTFDISK=y
BR2_PACKAGE_HOST_KMOD=y
BR2_PACKAGE_HOST_MKPASSWD=y
BR2_PACKAGE_CADS_EDGE=y
```

## buildroot-external/package/cads-edge/Config.in
```kconfig
config BR2_PACKAGE_CADS_EDGE
	bool "cads-edge"
	depends on BR2_INSTALL_LIBSTDCPP
	depends on BR2_TOOLCHAIN_GCC_AT_LEAST_10
	select BR2_PACKAGE_BOOST
	select BR2_PACKAGE_BOOST_PROGRAM_OPTIONS
	select BR2_PACKAGE_CPR
	select BR2_PACKAGE_EIGEN
	select BR2_PACKAGE_FLATBUFFERS
	select BR2_PACKAGE_FMT
	select BR2_PACKAGE_GTEST
	select BR2_PACKAGE_LUA
	select BR2_PACKAGE_OPENCV4
	select BR2_PACKAGE_PROTOBUF_C
	select BR2_PACKAGE_SPDLOG
	select BR2_PACKAGE_SQLITE
	select BR2_PACKAGE_TBB
	help
	  CADS Edge is a belt scanning application.

comment "cads-edge needs a toolchain w/ C++"
	depends on !(BR2_INSTALL_LIBSTDCPP && BR2_TOOLCHAIN_GCC_AT_LEAST_10)
```

## buildroot-external/package/cpr/Config.in
```kconfig
config BR2_PACKAGE_CPR
	bool "cpr"
	depends on BR2_INSTALL_LIBSTDCPP
	depends on BR2_USE_WCHAR
	select BR2_PACKAGE_LIBCURL
	select BR2_PACKAGE_OPENSSL
	help
	  C++ Requests is a simple wrapper around libcurl inspired by the
	  excellent Python Requests project.

	  https://docs.libcpr.org/

comment "cpr needs a toolchain w/ C++, wchar"
	depends on !BR2_INSTALL_LIBSTDCPP || !BR2_USE_WCHAR
```

## buildroot-external/package/hardware-nvidia/platform-t210-jetson/Config.in
```kconfig
config BR2_PACKAGE_PLATFORM_T210_JETSON
	bool
	help
	  NVIDIA T210 Jetson Device Tree Source

	  https://developer.nvidia.com/embedded/linux-tegra
```

## buildroot-external/package/hardware-nvidia/platform-tegra-common/Config.in
```kconfig
config BR2_PACKAGE_PLATFORM_TEGRA_COMMON
	bool
	help
	  NVIDIA Tegra Common Device Tree Source

	  https://developer.nvidia.com/embedded/linux-tegra
```

## buildroot-external/package/hardware-nvidia/soc-t210/Config.in
```kconfig
config BR2_PACKAGE_SOC_T210
	bool
	help
	  NVIDIA T210 Jetson hardware drivers

	  https://developer.nvidia.com/embedded/linux-tegra
```

## buildroot-external/package/linux-nvgpu/Config.in
```kconfig
config BR2_PACKAGE_LINUX_NVGPU
	bool
	help
	  The download helper for NVIDIA NVGPU Tegra driver kernel
	  patches.

	  https://developer.nvidia.com/embedded/linux-tegra
```

## cads-os/buildroot-external/Config.in
```kconfig
source "$BR2_EXTERNAL_DEFAULT_PATH/package/cads-config/Config.in"
source "$BR2_EXTERNAL_DEFAULT_PATH/package/tegra210/Config.in"
source "$BR2_EXTERNAL_DEFAULT_PATH/package/tegra210-usb-gadget/Config.in"
source "$BR2_EXTERNAL_DEFAULT_PATH/package/tegra210-wireguard/Config.in"
```

## cads-os/buildroot-external/configs/jetson_nano_defconfig
```kconfig
BR2_aarch64=y
BR2_cortex_a57=y
BR2_TOOLCHAIN_EXTERNAL=y
BR2_TOOLCHAIN_EXTERNAL_CUSTOM=y
BR2_TOOLCHAIN_EXTERNAL_DOWNLOAD=y
BR2_TOOLCHAIN_EXTERNAL_URL="https://developer.arm.com/-/media/Files/downloads/gnu/11.3.rel1/binrel/arm-gnu-toolchain-11.3.rel1-x86_64-aarch64-none-linux-gnu.tar.xz"
BR2_TOOLCHAIN_EXTERNAL_CUSTOM_PREFIX="$(ARCH)-none-linux-gnu"
BR2_TOOLCHAIN_EXTERNAL_GCC_11=y
BR2_TOOLCHAIN_EXTERNAL_HEADERS_4_20=y
BR2_TOOLCHAIN_EXTERNAL_CUSTOM_GLIBC=y
# BR2_TOOLCHAIN_EXTERNAL_INET_RPC is not set
BR2_TOOLCHAIN_EXTERNAL_CXX=y
BR2_GLOBAL_PATCH_DIR="$(BR2_EXTERNAL_DEFAULT_PATH)/patches"
BR2_INIT_SYSTEMD=y
BR2_SYSTEM_DEFAULT_PATH="/bin:/sbin:/usr/bin:/usr/sbin"
BR2_GENERATE_LOCALE="en_US"
BR2_ROOTFS_POST_IMAGE_SCRIPT="$(BR2_EXTERNAL_DEFAULT_PATH)/board/nvidia/jetson_nano/post-image.sh"
BR2_ROOTFS_POST_SCRIPT_ARGS="-c $(BR2_EXTERNAL_DEFAULT_PATH)/board/nvidia/jetson_nano/genimage.cfg"
BR2_PACKAGE_OPENSSL=y
BR2_PACKAGE_SQLITE=y
BR2_PACKAGE_OPENCV4=y
BR2_PACKAGE_LIBCURL=y
BR2_PACKAGE_BOOST=y
BR2_PACKAGE_BOOST_PROGRAM_OPTIONS=y
BR2_PACKAGE_TBB=y
BR2_PACKAGE_DROPBEAR=y
BR2_TARGET_ROOTFS_EXT2=y
BR2_TARGET_ROOTFS_EXT2_4=y
BR2_TARGET_ROOTFS_EXT2_SIZE="4000M"
BR2_TARGET_ROOTFS_EXT2_MKFS_OPTIONS=""
BR2_PACKAGE_HOST_ENVIRONMENT_SETUP=y
BR2_PACKAGE_HOST_GENIMAGE=y
BR2_PACKAGE_HOST_GPTFDISK=y
BR2_PACKAGE_HOST_MKPASSWD=y
BR2_PACKAGE_LINUX4TEGRA_LEGACY=y
```

## cads-os/buildroot-external/package/cads-config/Config.in
```kconfig
config BR2_PACKAGE_CADS_CONFIG
	bool "cads-config"
	depends on BR2_INIT_SYSTEMD
	select BR2_PACKAGE_OPENSSL
	select BR2_PACKAGE_SQLITE
	select BR2_PACKAGE_OPENCV4
	select BR2_PACKAGE_LIBCURL
	select BR2_PACKAGE_BOOST
	select BR2_PACKAGE_BOOST_PROGRAM_OPTIONS
	select BR2_PACKAGE_TBB
	select BR2_PACKAGE_TEGRA210
	select BR2_PACKAGE_TEGRA210_USB_GADGET
	select BR2_PACKAGE_TEGRA210_WIREGUARD
	select BR2_PACKAGE_WIREGUARD_TOOLS
	help
	  System level configuration for CADS edge device
```

## cads-os/buildroot-external/package/cads-support/Config.in
```kconfig
config BR2_PACKAGE_CADS_SUPPORT
	bool "cads-support"
	depends on BR2_INIT_SYSTEMD
	select BR2_PACKAGE_OPENSSL
	select BR2_PACKAGE_SQLITE
	select BR2_PACKAGE_OPENCV4
	select BR2_PACKAGE_LIBCURL
	select BR2_PACKAGE_BOOST
	select BR2_PACKAGE_BOOST_PROGRAM_OPTIONS
	select BR2_PACKAGE_TBB
	select BR2_PACKAGE_TEGRA210
	select BR2_PACKAGE_WIREGUARD_TEGRA210
	select BR2_PACKAGE_WIREGUARD_TOOLS
	help
	  Support package for CADS system
```

## cads-os/buildroot-external/package/hardware-nvidia/platform-t210-common/Config.in
```kconfig
config BR2_PACKAGE_PLATFORM_T210_COMMON
	bool
	help
	  NVIDIA T210 Common hardware drivers

	  https://developer.nvidia.com/embedded/linux-tegra
```

## cads-os/buildroot-external/package/hardware-nvidia/platform-t210-porg/Config.in
```kconfig
config BR2_PACKAGE_PLATFORM_T210_PORG
	bool
	help
	  NVIDIA T210 Porg Device Tree Source

	  https://developer.nvidia.com/embedded/linux-tegra
```

## cads-os/buildroot-external/package/hardware-nvidia/soc-tegra/Config.in
```kconfig
config BR2_PACKAGE_SOC_TEGRA
	bool
	help
	  NVIDIA Tegra Jetson hardware drivers

	  https://developer.nvidia.com/embedded/linux-tegra
```

## cads-os/buildroot-external/package/linux-nvidia/Config.in
```kconfig
config BR2_PACKAGE_LINUX_NVIDIA
	bool
	help
	  NVIDIA Linux source code for Tegra

	  https://developer.nvidia.com/embedded/linux-tegra
```

## cads-os/buildroot-external/package/linux4tegra-legacy/Config.in
```kconfig
config BR2_PACKAGE_LINUX4TEGRA_LEGACY
	bool "linux4tegra"
	help
	  Supports discontinued boards: Jetson Nano, TX1, TX2.

	  https://developer.nvidia.com/embedded/linux-tegra-archive

if BR2_PACKAGE_LINUX4TEGRA_LEGACY

choice
	prompt "Platform"
	default BR2_PACKAGE_LINUX4TEGRA_LEGACY_PLATFORM_T210REF
	help
	  Select the platform variant for linux4tegra-legacy.

config BR2_PACKAGE_LINUX4TEGRA_LEGACY_PLATFORM_T210REF
	bool "t210ref"
	help
	  Jetson Nano or Jetson TX1

config BR2_PACKAGE_LINUX4TEGRA_LEGACY_PLATFORM_T186REF
	bool "t186ref"
	help
	  Jetson TX2

endchoice

endif # if BR2_PACKAGE_LINUX4TEGRA_LEGACY
```

## cads-os/buildroot-external/package/tegra210-usb-gadget/Config.in
```kconfig
config BR2_PACKAGE_TEGRA210_USB_GADGET
	bool "tegra210-usb-gadget"
	depends on BR2_PACKAGE_TEGRA210
	help
	  USB gadget support
```

## cads-os/buildroot-external/package/tegra210/Config.in
```kconfig
config BR2_PACKAGE_TEGRA210_SUPPORTS
	bool
	default y
	depends on BR2_cortex_a57

config BR2_PACKAGE_TEGRA210
	bool "tegra210"
	depends on BR2_PACKAGE_TEGRA210_SUPPORTS
    select BR2_PACKAGE_HOST_KMOD
    select BR2_PACKAGE_HOST_PYTHON3
	help
	  Linux Tegra210 Board Support Package

	  https://developer.nvidia.com/embedded/linux-tegra-archive

comment "tegra210 only works on aarch64"
	depends on !BR2_PACKAGE_TEGRA210_SUPPORTS
```
